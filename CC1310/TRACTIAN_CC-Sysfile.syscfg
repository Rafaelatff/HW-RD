/**
 * @cliArgs --device "CC1310RHB" --package "RHB" --part "Default"
 * @versions {"tool":"1.12.0+2406"}
 */

/**
 * These are the peripherals and settings in this configuration
 */
const iGPIO1        = scripting.addPeripheral("GPIO");
iGPIO1["0"].$assign = "ball.24";
iGPIO1.$name        = "I2C_INT";
const iGPIO2        = scripting.addPeripheral("GPIO");
iGPIO2["0"].$assign = "ball.9";
iGPIO2.$name        = "LED_CC";
const iI2C1         = scripting.addPeripheral("I2C");
iI2C1.$name         = "MyI2C1";
iI2C1.SDA.$assign   = "ball.26";
iI2C1.SCL.$assign   = "ball.25";
const iJTAG1        = scripting.addPeripheral("JTAG");
iJTAG1.$name        = "MyJTAG1";

/**
 * Pinmux solution for unlocked pins/peripherals. This ensures that minor changes to the automatic solver in a future
 * version of the tool will not impact the pinmux you originally saw.  These lines can be completely deleted in order to
 * re-solve from scratch.
 */
iI2C1.$suggestSolution       = "I2C0";
iJTAG1.$suggestSolution      = "JTAG";
iJTAG1.TDI.$suggestSolution  = "ball.16";
iJTAG1.TDO.$suggestSolution  = "ball.15";
iJTAG1.TMSC.$suggestSolution = "ball.13";
iJTAG1.TCKC.$suggestSolution = "ball.14";
